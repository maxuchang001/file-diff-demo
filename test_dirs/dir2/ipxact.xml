# TestComponent: IP-XACT component
VLNV TestVendor:TestLibrary:TestComponent:2.0

## Parameters
DATA_WIDTH = 64
FREQ = 200

## Bus interfaces (logical=physical port)
AXI4: master ::axi4:2.0, address space mem_space
AHB: slave ::ahb:1.0, memory map reg_map

## Address spaces and blocks
mem_space: range 0x2000000, width 64
reg_map.CTRL: base 0x1000, range 0x2000, width 32

## Registers
Registers are 32-bit, read-write, no defined reset value unless marked. A register's access mark holds for its fields unless they carry their own. Offsets are from the block's base; lines under a group give offsets from that group; [hi:lo] are bit positions; {n}, {i} and the like mark numbered series; 'fields as' and 'values as' point back to an identical list; <NAME> marks a mode.

## reg_map.CTRL
Base 0x00001000
0x00 CTRL
  [1:0] ENABLE
0x04 STATUS ro
  [0] DONE
